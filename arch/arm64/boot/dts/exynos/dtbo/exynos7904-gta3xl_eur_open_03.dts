/*
 * SAMSUNG EXYNOS7904 board device tree source

 *
 * Copyright (c) 2018 Samsung Electronics Co., Ltd.
 *		http://www.samsung.com
 *
 * This program is free software; you can redistribute it and/or modify
 * it under the terms of the GNU General Public License version 2 as
 * published by the Free Software Foundation.
*/

/dts-v1/;
/plugin/;

#include "exynos7904-gta3xl_common.dtsi"
#include "exynos7904-gta3xl_eur_open_gpio_03.dtsi"
#include "ccic-s2mm005_gta3xllte_00.dtsi"

/ {
	compatible = "samsung,GTA3XL EUR OPEN 02", "samsung,EXYNOS7904";

	dtbo-hw_rev = <3>;
    dtbo-hw_rev_end = <255>;


	fragment@model {
		target-path = "/";
		__overlay__ {
			#address-cells = <2>;
			#size-cells = <1>;

			model = "Samsung GTA3XL EUR OPEN 02 board based on EXYNOS7904";

		}; /* end of __overlay__ */
	}; /* end of fragment */
}; /* end of root */
